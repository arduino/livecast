/*
    LED Matrix controlled through Bluetooth

    Control a NeoPixel LED matrix using a HC-06 
    Bluetooth module.

    Using arrays generated by PixelCrafter, made by
    (c) David Cuartielles, 2018 we create different screens
    that can be triggered through Bluetooth.

    (c) 2018 Karl, Josefine, and David for Arduino
    this code is GPLv3

    based on code by Mayoogh Girish (c) 2016

*/
#include <Adafruit_NeoPixel.h>
#include "ledData.h"


#ifdef __AVR__
#include <avr/power.h>
#endif
#define PIN            6
#define NUMPIXELS      256



Adafruit_NeoPixel pixels = Adafruit_NeoPixel(NUMPIXELS, PIN, NEO_GRB + NEO_KHZ800);

//stores data
char data = 0;

void setup() {

  Serial.begin(9600);
  pixels.begin(); // This initializes the NeoPixel library.
}

void loop() {

  //check if we receive any data
  if (Serial.available() > 0)     // Send data only when you receive data:
  {
    data = Serial.read();        //Read incoming value and stores into data
    Serial.print(data);          //Prints value to serial monitor
    Serial.print("\n");
    
    //if data equals 1 the 'showImage()' function will execute every 1 second
    if (data == '1') {
      showImage();
      delay(1000);
      clearImage();
      delay(1000);
      showImage();
      delay(1000);
      clearImage();
      delay(1000);
      showImage();
      delay(1000);
      clearImage();
      delay(1000);
    }

    //if data equals 2 the 'showImage2()' function will execute every 1 second
    else if (data == '2')  {
      showImage2();
      delay(1000);
      clearImage();
      delay(1000);
      showImage2();
      delay(1000);
      clearImage();
      delay(1000);
      showImage2();
      delay(1000);
      clearImage();
      delay(1000);
    }

    //if data equals 3 the 'showImage3()' function will execute every 1 second
    else if (data == '3')  {
      showImage3();
      delay(1000);
      clearImage();
      delay(1000);
      showImage3();
      delay(1000);
      clearImage();
      delay(1000);
      showImage3();
      delay(1000);
      clearImage();
    }
  }
}


void showImage() {
  for (int i = 0; i < NUMPIXELS; i++) {
    // since we are working with no external battery power,
    // we need to map the maximum values of the light intensity
    // to 100, to avoid taking too much current from the USB port
    byte red = map(palette[3 * ledPixels[i]], 0, 255, 0, 100);
    byte green = map(palette[3 * ledPixels[i] + 1], 0, 255, 0, 100);
    byte blue = map(palette[3 * ledPixels[i] + 2], 0, 255, 0, 100);
    pixels.setPixelColor(i, pixels.Color(red, green, blue));
  }

  pixels.show();
}

void showImage2() {
  for (int i = 0; i < NUMPIXELS; i++) {
    // since we are working with no external battery power,
    // we need to map the maximum values of the light intensity
    // to 100, to avoid taking too much current from the USB port
    byte red = map(palette2[3 * ledPixels2[i]], 0, 255, 0, 100);
    byte green = map(palette2[3 * ledPixels2[i] + 1], 0, 255, 0, 100);
    byte blue = map(palette2[3 * ledPixels2[i] + 2], 0, 255, 0, 100);
    pixels.setPixelColor(i, pixels.Color(red, green, blue));
  }

  pixels.show();
}

void showImage3() {
  for (int i = 0; i < NUMPIXELS; i++) {
    // since we are working with no external battery power,
    // we need to map the maximum values of the light intensity
    // to 100, to avoid taking too much current from the USB port
    byte red = map(palette3[3 * ledPixels3[i]], 0, 255, 0, 100);
    byte green = map(palette3[3 * ledPixels3[i] + 1], 0, 255, 0, 100);
    byte blue = map(palette3[3 * ledPixels3[i] + 2], 0, 255, 0, 100);
    pixels.setPixelColor(i, pixels.Color(red, green, blue));
  }

  pixels.show();
}



//Clears the LED matrix
void clearImage() {
  for (int i = 0; i < NUMPIXELS; i++)
    pixels.setPixelColor(i, pixels.Color(0, 0, 0));

  pixels.show();
}


